## main/Kconfig.projbuild
```kconfig
menu "Ozone configuration"
    menu "General"
        config DEBUG_MODE
            bool "Enable debug mode"
            default n

        config ZIGBEE_COMMUNICATION_ENABLED
            bool "Enable ZigBee communication"
            default n
    endmenu

    menu "Communication"
        menu "ZigBee"
            choice ZIGBEE_POWER_SOURCE
                prompt "Power source"
                default ZIGBEE_POWER_SOURCE_DC

                config ZIGBEE_POWER_SOURCE_DC
                    bool "DC source"
            endchoice

        endmenu
    endmenu

    menu "I2C"
        config I2C_MASTER_SDA
            int "SDA"
            default 1
        config I2C_MASTER_SCL
            int "SCL"
            default 2

        choice I2C_FREQUENCY
                prompt "I2C frequency"
                default I2C_FREQ_STANDARD

                config I2C_FREQ_STANDARD
                    bool "100 kHz"
                config I2C_FREQ_FAST
                    bool "400 kHz"
            endchoice
    endmenu

    menu "Sensors"
        menu "Anemometer"
            config ANEMOMETER_ENABLED
                bool "Enable anemometer"
                default n

            choice ANEMOMETER_TYPE
                depends on ANEMOMETER_ENABLED
                prompt "Anemometer type"
                default ANEMOMETER_TYPE_ADS1115

                config ANEMOMETER_TYPE_ADS1115
                    bool "Anemometer via ADS1115 ADC"
            endchoice

            config ANEMOMETER_CHANNEL_TO_USE
                depends on ANEMOMETER_TYPE_ADS1115
                int "Channel to use"
                range 0 3
                default 0
                help
                    Channel to use between 0 and 3.

            config ANEMOMETER_READ_INTERVAL_MS
                depends on ANEMOMETER_ENABLED
                int "Reading interval"
                default 2000
                help
                    Time between two readings (in milliseconds)

            config ANEMOMETER_MAX_RANGE
                depends on ANEMOMETER_ENABLED
                int "Anemometer Max Range (m/s)"
                default 0

            config ANEMOMETER_CALIBRATION_MIN
                depends on ANEMOMETER_ENABLED
                int "Anemometer calibration (MIN)"
                default 0

            config ANEMOMETER_CALIBRATION_MAX
                depends on ANEMOMETER_ENABLED
                int "Anemometer calibration (MAX)"
                default 26598

            choice ANEMOMETER_CONVERSION_UNIT
                depends on ANEMOMETER_ENABLED
                prompt "Anemometer conversion unit to use"
                default ANEMOMETER_CONVERSION_UNIT_KMH

                config ANEMOMETER_CONVERSION_UNIT_KMH
                    bool "KMH"

                config ANEMOMETER_CONVERSION_UNIT_MPH
                    bool "MPH"
            endchoice
        endmenu

        menu "Humidity"
            config HUMIDITY_SENSOR_ENABLED
                bool "Enable humidity sensor"
                default n

            choice HUMIDITY_SENSOR_TYPE
                depends on HUMIDITY_SENSOR_ENABLED
                prompt "Humidity sensor type"
                default HUMIDITY_SENSOR_TYPE_BME280

                config HUMIDITY_SENSOR_TYPE_BME280
                    bool "BME280"
            endchoice
        endmenu

        menu "Illuminance"
            config ILLUMINANCE_SENSOR_ENABLED
                bool "Enable illuminance sensor"
                default n

            choice ILLUMINANCE_SENSOR_TYPE
                depends on ILLUMINANCE_SENSOR_ENABLED
                prompt "Illuminance sensor type"
                default ILLUMINANCE_SENSOR_TYPE_BH1750

                config ILLUMINANCE_SENSOR_TYPE_BH1750
                    bool "BH1750"
            endchoice
        endmenu

        menu "Pressure"
            config PRESSURE_SENSOR_ENABLED
                bool "Enable pressure sensor"
                default n

            choice PRESSURE_SENSOR_TYPE
                depends on PRESSURE_SENSOR_ENABLED
                prompt "Pressure sensor type"
                default PRESSURE_SENSOR_TYPE_BME280

                config PRESSURE_SENSOR_TYPE_BME280
                    bool "BME280"
            endchoice
        endmenu

        menu "Temperature"
            config TEMPERATURE_SENSOR_ENABLED
                bool "Enable temperature sensor"
                default n

            choice TEMPERATURE_SENSOR_TYPE
                depends on TEMPERATURE_SENSOR_ENABLED
                prompt "Temperature sensor type"
                default TEMPERATURE_SENSOR_TYPE_BME280

                config TEMPERATURE_SENSOR_TYPE_BME280
                    bool "BME280"
            endchoice
        endmenu

        menu "Wind vane"
            config WIND_VANE_ENABLED
                bool "Enable wind vane"
                default n

            choice WIND_VANE_TYPE
                depends on WIND_VANE_ENABLED
                prompt "Wind vane type"
                default WIND_VANE_TYPE_ADS1115

                config WIND_VANE_TYPE_ADS1115
                    bool "Wind vane via ADS1115 ADC"
            endchoice

            config WIND_VANE_CHANNEL_TO_USE
                depends on WIND_VANE_TYPE_ADS1115
                int "Channel to use"
                range 0 3
                default 1
                help
                    Channel to use between 0 and 3.

            config WIND_VANE_READ_INTERVAL_MS
                depends on WIND_VANE_ENABLED
                int "Reading interval"
                help
                    Time between two readings (in milliseconds)
                default 2000

            choice WIND_VANE_RESOLUTION
                depends on WIND_VANE_ENABLED
                prompt "Wind vane resolution"
                default WIND_VANE_RESOLUTION_8_POINTS

                config WIND_VANE_RESOLUTION_8_POINTS
                    bool "8 cardinal points"
            endchoice

            config WIND_VANE_CALIBRATION_N
                depends on WIND_VANE_RESOLUTION_8_POINTS
                int "Wind vane calibration (N)"
                default 0

            config WIND_VANE_CALIBRATION_NE
                depends on WIND_VANE_RESOLUTION_8_POINTS
                int "Wind vane calibration (NE)"
                default 3800

            config WIND_VANE_CALIBRATION_E
                depends on WIND_VANE_RESOLUTION_8_POINTS
                int "Wind vane calibration (E)"
                default 7599

            config WIND_VANE_CALIBRATION_SE
                depends on WIND_VANE_RESOLUTION_8_POINTS
                int "Wind vane calibration (SE)"
                default 11399

            config WIND_VANE_CALIBRATION_S
                depends on WIND_VANE_RESOLUTION_8_POINTS
                int "Wind vane calibration (S)"
                default 15199

            config WIND_VANE_CALIBRATION_SW
                depends on WIND_VANE_RESOLUTION_8_POINTS
                int "Wind vane calibration (SW)"
                default 18999

            config WIND_VANE_CALIBRATION_W
                depends on WIND_VANE_RESOLUTION_8_POINTS
                int "Wind vane calibration (W)"
                default 22798

            config WIND_VANE_CALIBRATION_NW
                depends on WIND_VANE_RESOLUTION_8_POINTS
                int "Wind vane calibration (NW)"
                default 26598
        endmenu
    endmenu

    menu "Components"
        source "../components/ads1115/ads1115.kconfig"
        source "../components/bh1750/bh1750.kconfig"
        source "../components/bme280/bme280.kconfig"
    endmenu
endmenu
```
